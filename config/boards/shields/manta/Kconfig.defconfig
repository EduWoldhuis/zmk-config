## config/boards/shields/manta/Kconfig.defconfig
```kconfig
if SHIELD_manta_LEFT

config ZMK_KEYBOARD_NAME
    default "manta"

config ZMK_SPLIT_ROLE_CENTRAL
    default y

endif

if SHIELD_manta_LEFT || SHIELD_manta_RIGHT

config ZMK_BLE_EXPERIMENTAL_CONN
    default y

config ZMK_SPLIT
    default y


endif
```

## config/boards/shields/manta/Kconfig.shield
```kconfig
config SHIELD_manta_LEFT
    def_bool $(shields_list_contains,manta_left)

config SHIELD_manta_RIGHT
    def_bool $(shields_list_contains,manta_right)
```
